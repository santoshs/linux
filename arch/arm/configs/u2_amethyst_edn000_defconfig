## drivers/sensor/gyroscope/Kconfig
```kconfig
##############################################################
################ L3GD20 driver configuration ###############
##############################################################

menuconfig L3GD20_DRIVER
	bool "Gyroscope driver enable"
	default y
	help
	  	Enable driver for L3GD20 chip
		
if L3GD20_DRIVER
	source "drivers/sensor/gyroscope/l3gd20/Kconfig"
endif
```

## drivers/sensor/gyroscope/l3gd20/Kconfig
```kconfig
##############################################################
################ Gyroscope driver configuration ##############
##############################################################

comment "Gyroscope driver support"

config GYROSCOPE
	tristate "Gyroscope driver enable"
	default m

	help
	  	Enable Gyroscope driver
		
config L3GD20_POLLING
	bool "Gyroscope polling model"
	default y

	help
	  	Enable polling mechanism for L3GD20 chip. If interrupt will be
		used, please select n
```

## drivers/sensor/proximity/Kconfig
```kconfig
##############################################################
################ BH1771GLC driver configuration ###############
##############################################################

menuconfig BH1771GLC_DRIVER
	bool "Light and proximity driver enable"
	default y
	help
	  	Enable driver for BH1771GLC chip
		
if BH1771GLC_DRIVER
	source "drivers/sensor/proximity/bh1771glc/Kconfig"
endif
```

## drivers/sensor/proximity/bh1771glc/Kconfig
```kconfig
##############################################################
##########	Proximity and ambient light driver  ##############
##############################################################

comment "Proximity and ambient light driver support"

config PROXIMITY
	tristate "Proximity and ambient light driver enable"
	default m

	help
	  	Enable Proximity and ambient light driver
		
config PROXIMITY_POLLING
	bool "Proximity polling model"
	default y

	help
	  	Enable polling mechanism for Proximity. If interrupt will be
		used, please select n
```

## drivers/smeco/Kconfig
```kconfig
#
# Smeco Linux Kernel Module Configuration file
#

menuconfig SMECO
	tristate "Shared Memory IPC support (SMeCo / SMC)"
	default y
	---help---
	The Shared Memory IPC (SMeCo) is used between APE and Modem.

if SMECO

config SMECO_CONTROL
	boolean "Use SMeCo / SMC Control Instance"
	default y
	---help---
	If this is selected the SMC control channels between CPUs are taken in use

if SMECO_CONTROL
config SMECO_CONTROL_USE_PHONET
    boolean "Use Phonet protocl in SMC Control"
    default y
     ---help---
	If this is selected the SMC control uses phonet protocol for communication
	
endif

config SMECO_L2MUX
	boolean "Use L2MUX in SMeCo / SMC"
	default y
	
	
config SMECO_TRACES_ENABLED
	boolean "Activate SMeCo / SMC traces"
	default n

if SMECO_TRACES_ENABLED
	config SMECO_TRACES_KERN_ALERT
		boolean "Print SMeCo/SMC traces in KERN_ALERT mode"
		default n
		 ---help---
		If this is selected the SMC traces are printed in KERN_ALERT mode
endif

config SMECO_TEST
	tristate "SMeCo SMC Test Features"
	default n
	---help---
	If this option is selected the SMeCo test cases are built in the package.
	
config SMECO_TEST_MODULE
	tristate "SMeCo SMC Test Module"
	default n
	---help---
	If this option is selected the SMeCo test application module is built in the package.

endif
```

## drivers/thermal/thermal_sensor/Kconfig
```kconfig
config THERMAL_SENSOR
	bool "Temperature module (Renesas)"
	depends on ARCH_SHMOBILE
	default n
	help
	  Temperature module is used to measure temperature of areas in LSI of Renesas.
	  
config THS_DEBUG_ENABLE
	bool "Debug information for Thermal Sensor driver"
	depends on THERMAL_SENSOR
	default n
	help
		This config helps to print debug information in terminal.
	  
```

## drivers/video/av7100/Kconfig
```kconfig
config AV7100
       tristate "AV7100 driver support(HDMI/CVBS)"
       default y
       help
           Please enable this feature if hdmi/tvout driver support is required.

config AV7100_HWTRIG_I2SDAT3
	bool "AV7100 HW trig on I2SDAT3"
	default y
	depends on AV7100
	---help---
	  If you say Y here AV7100 will use HW triggering
	  from AV7100 I2SDAT3 to MCDE sync1.
	  If you say N here AV7100 will use HW triggering
	  method from AV7100 INT to MCDE sync0.

config HDMI_AV7100_DEBUG
	bool "HDMI and AV7100 debug messages"
	default y
	depends on AV7100
	---help---
	  Say Y here if you want the HDMI and AV7100 driver to output debug messages
```

## drivers/video/r-mobile/Kconfig
```kconfig
config FB_SH_MOBILE_LCDC
        tristate "SuperH Mobile LCDC framebuffer support"
        depends on FB && (SUPERH || ARCH_SHMOBILE) && HAVE_CLK
        select FB_SYS_FILLRECT
        select FB_SYS_COPYAREA
        select FB_SYS_IMAGEBLIT
        select FB_SYS_FOPS
        select FB_DEFERRED_IO
        select FB_BACKLIGHT
        select SH_MIPI_DSI if SH_LCD_MIPI_DSI
        ---help---
          Frame buffer driver for the on-chip SH-Mobile LCD controller.

choice
        depends on FB_SH_MOBILE_LCDC
        prompt "panel select"
        default FB_R_MOBILE_PANEL_KOTA
        help
          Selected panel

config FB_R_MOBILE_PANEL_KOTA
        boolean "KOTA PANEL"

config FB_R_MOBILE_S6E39A0X02
        boolean "S6E39A0X02 PANEL"

config FB_R_MOBILE_HX8369_B
        boolean "HX8369_B PANEL"

endchoice

choice
        depends on FB_SH_MOBILE_LCDC
        prompt "hdmi select"
        default FB_R_MOBILE_HDMI_KOTA
        help
          Selected hdmi

config FB_R_MOBILE_HDMI_KOTA
        boolean "KOTA HDMI"

endchoice

config FB_SH_MOBILE_DOUBLE_BUF
        bool "SuperH Mobile double buffer support"
        depends on FB_SH_MOBILE_LCDC
        default y
        help
          SuperH Mobile LCDC framebuffer support double buffer.
```
