## arch/arm/mach-shmobile/Kconfig
```kconfig
if ARCH_SHMOBILE

comment "SH-Mobile System Type"

config ARCH_SH7367
	bool "SH-Mobile G3 (SH7367)"
	select CPU_V6
	select SH_CLK_CPG
	select ARCH_WANT_OPTIONAL_GPIOLIB

config ARCH_SH7377
	bool "SH-Mobile G4 (SH7377)"
	select CPU_V7
	select SH_CLK_CPG
	select ARCH_WANT_OPTIONAL_GPIOLIB

config ARCH_SH7372
	bool "SH-Mobile AP4 (SH7372)"
	select CPU_V7
	select SH_CLK_CPG
	select ARCH_WANT_OPTIONAL_GPIOLIB

config ARCH_SH73A0
	bool "SH-Mobile AG5 (R8A73A00)"
	select CPU_V7
	select SH_CLK_CPG
	select ARCH_WANT_OPTIONAL_GPIOLIB
	select ARM_GIC
	select I2C

config ARCH_R8A7740
	bool "R-Mobile A1 (R8A77400)"
	select CPU_V7
	select SH_CLK_CPG
	select ARCH_WANT_OPTIONAL_GPIOLIB

config ARCH_R8A7779
	bool "R-Car H1 (R8A77790)"
	select CPU_V7
	select SH_CLK_CPG
	select ARM_GIC
	select ARCH_WANT_OPTIONAL_GPIOLIB

config ARCH_R8A7373
	bool "R-Mobile U2 (R8A7373)"
	select CPU_V7
	select SH_CLK_CPG
	select ARM_GIC
	select ARCH_WANT_OPTIONAL_GPIOLIB
	select CLKSRC_MMIO

config ARCH_R8A73734
	bool "R-Mobile U2 (R8A73734)"
	select CPU_V7
	select SH_CLK_CPG
	select ARCH_WANT_OPTIONAL_GPIOLIB
	select ARM_GIC
	select CLKSRC_MMIO
	select HAVE_SCHED_CLOCK

comment "SH-Mobile Board Type"

config MACH_G3EVM
	bool "G3EVM board"
	depends on ARCH_SH7367
	select ARCH_REQUIRE_GPIOLIB

config MACH_G4EVM
	bool "G4EVM board"
	depends on ARCH_SH7377
	select ARCH_REQUIRE_GPIOLIB

config MACH_AP4EVB
	bool "AP4EVB board"
	depends on ARCH_SH7372
	select ARCH_REQUIRE_GPIOLIB
	select SH_LCD_MIPI_DSI
	select SND_SOC_AK4642 if SND_SIMPLE_CARD

choice
	prompt "AP4EVB LCD panel selection"
	default AP4EVB_QHD
	depends on MACH_AP4EVB

config AP4EVB_QHD
	bool "MIPI-DSI QHD (960x540)"

config AP4EVB_WVGA
	bool "Parallel WVGA (800x480)"

endchoice

config MACH_AG5EVM
	bool "AG5EVM board"
	select ARCH_REQUIRE_GPIOLIB
	select SH_LCD_MIPI_DSI
	depends on ARCH_SH73A0

config MACH_MACKEREL
	bool "mackerel board"
	depends on ARCH_SH7372
	select ARCH_REQUIRE_GPIOLIB
	select SND_SOC_AK4642 if SND_SIMPLE_CARD

config MACH_KOTA2
	bool "KOTA2 board"
	select ARCH_REQUIRE_GPIOLIB
	depends on ARCH_SH73A0

config MACH_BONITO
	bool "bonito board"
	select ARCH_REQUIRE_GPIOLIB
	depends on ARCH_R8A7740

config MACH_MARZEN
	bool "MARZEN board"
	depends on ARCH_R8A7779
	select ARCH_REQUIRE_GPIOLIB

config MACH_U2EVM
	bool "U2EVM board"
	depends on ARCH_R8A7373
	select ARCH_REQUIRE_GPIOLIB
	select SH_LCD_MIPI_DSI

config MACH_U2EVM
	bool "U2EVM board"
	select ARCH_REQUIRE_GPIOLIB
	depends on ARCH_R8A73734

config MACH_U2USB
	bool "U2USB board"
	select ARCH_REQUIRE_GPIOLIB
	depends on ARCH_R8A73734

config U2_ES1
	bool "U2 ES1.0"
	default y
	depends on ARCH_R8A73734
	help
	  R-Mobile-U2 Engineering Sample 1.0.

config U2_STM_ETR_TO_SDRAM
	bool "U2 STM ETR to SDRAM"
	depends on ARCH_R8A73734
	help
	  R-Mobile-U2 STM Traces through ETR to SDRAM.

comment "SH-Mobile System Configuration"

config CPU_HAS_INTEVT
        bool
	default y

menu "Memory configuration"

config MEMORY_START
	hex "Physical memory start address"
	default "0x50000000" if MACH_G3EVM
	default "0x40000000" if MACH_G4EVM || MACH_AP4EVB || MACH_AG5EVM || \
				MACH_MACKEREL || MACH_BONITO
	default "0x41000000" if MACH_KOTA2
	default "0x50000000" if MACH_U2EVM
	default "0x00000000"
	---help---
	  Tweak this only when porting to a new machine which does not
	  already have a defconfig. Changing it from the known correct
	  value on any of the known systems will only lead to disaster.

config MEMORY_SIZE
	hex "Physical memory size"
	default "0x08000000" if MACH_G3EVM
	default "0x08000000" if MACH_G4EVM
	default "0x20000000" if MACH_AG5EVM || MACH_BONITO
	default "0x1e000000" if MACH_KOTA2
	default "0x10000000" if MACH_AP4EVB || MACH_MACKEREL
	default "0x30000000" if MACH_U2EVM
	default "0x04000000"
	help
	  This sets the default memory size assumed by your kernel. It can
	  be overridden as normal by the 'mem=' argument on the kernel command
	  line.

endmenu

menu "Timer and clock configuration"

config SHMOBILE_TIMER_HZ
	int "Kernel HZ (jiffies per second)"
	range 32 1024
	default "128"
	help
	  Allows the configuration of the timer frequency. It is customary
	  to have the timer interrupt run at 1000 Hz or 100 Hz, but in the
	  case of low timer frequencies other values may be more suitable.
	  SH-Mobile systems using a 32768 Hz RCLK for clock events may want
	  to select a HZ value such as 128 that can evenly divide RCLK.
	  A HZ value that does not divide evenly may cause timer drift.

config SH_TIMER_CMT
	bool "CMT timer driver"
	help
	  This enables build of the CMT timer driver.

endmenu

config SH_CLK_CPG
	bool

menu "Modem STM trace and debug configuration"

config MUX_STM_TO_SDHI1
        bool "Mux STM to SDHI1"
        default y
        help
          Mux STM CLK, DATA0-3, and SIDI to SDHI1 interface.

endmenu

menu "SH-Mobile TrustZone Configuration"
config ARM_TZ
	bool "ARM trustzone (TZ) Configuration."
        default n
#       depends ARM
        ---help---
        ARM trustzone (TZ) Configuration.
endmenu

menu "SH-Mobile CPUFreq Setting"
config SHMOBILE_CPUFREQ
	bool "SH-Mobile has CPUFreq support"
	depends on ARCH_SHMOBILE
	select ARCH_HAS_CPUFREQ
	default n

config SH_TRANSITION_LATENCY
	int "Transition Latency (ms)"
	range 10 1000
	default "50"
	depends on SHMOBILE_CPUFREQ
	help
	  Transition latency between each sampling.

config SH_UP_THRESHOLD
	int "Up threshold (%)"
	range 50 100
	default "80"
	depends on SHMOBILE_CPUFREQ
	help
	  Upper threshold.

config SH_DOWN_THRESHOLD
	int "Down threshold (%)"
	range 10 50
	default "20"
	depends on SHMOBILE_CPUFREQ
	help
	  Lower threshold.

config SH_FRQ_STEP
	int "Transition frequency step (%)"
	range 1 100
	default "15"
	depends on SHMOBILE_CPUFREQ
	help
	  Frequency Step.
endmenu


config PDC
	bool "Power Domain Control"
	default n
	depends on PM_RUNTIME
	help
	  This enables build of PDC driver.
	  
config PM_HAS_SECURE
	default y
	bool "Support Secure OS by Power Management"
	depends on ARCH_SHMOBILE
	depends on ARM_SEC_HAL
	help
	  This enables PM support for Secure OS.

config HOTPLUG_ARCH_R8A73734
	default y
	bool "Support CPU Hotplug for R-MobileU2"
	depends on HOTPLUG_CPU
	help
	  This CPU Hotplug for R-MobileU2

config HOTPLUG_CPU_MGR
	default y
	bool "Support CPU Hotplug Manager for R-MobileU2 New power consumption"
	depends on HOTPLUG_CPU
	depends on ARCH_SHMOBILE
	depends on HOTPLUG_ARCH_R8A73734
	help
	  This CPU Hotplug Manager for R-MobileU2 New power consumption
	  It relatd to 3 modules: Dynamic Frequency Scaling (DFS), Hotplug
	  and Sleep (WFI)/CoreStandy)

source "drivers/sh/Kconfig"

config MACH_U2EVM_SR_REV031
	bool "New borad version V0.3.1"
	default n

config RENESAS
	bool "Renesas reference implementations"
	default n

config RENESAS_BT
	bool "Renesas reference implementation for BT"
	default n
	depends on RENESAS

config RENESAS_NFC
	bool "Renesas reference implementation for NFC"
	default n
	depends on RENESAS

config RENESAS_GPS
	bool "Renesas reference implementation for GPS"
	default n
	depends on RENESAS
config BRCM_UNIFIED_DHD_SUPPORT
	bool "Renesas reference implementation for WiFi"
	default n
config RENESAS_WIFI
	bool "Renesas reference implementation for WiFi"
	default n
	depends on BRCM_UNIFIED_DHD_SUPPORT

config BOARD_VERSION_V050
	default y
	bool "board_revision"
	help
	  Board revision 
comment "Debugging Feature"

menuconfig SEC_DEBUG
      bool "Samsung TN Ramdump Feature"
       default y
       help
         Samsung TN Ramdump Feature. Use INFORM3 and magic number at 0xc0000000.
         enable this to use Ramdump secondary handler

if SEC_DEBUG

config SEC_DEBUG_USER
        bool "Panic on Userspace fault"
        default y
        help
          Panic on Userspace fault

menuconfig SEC_DEBUG_INFORM
        bool "Samsung TN Ramdump information region on memory"
        default y
        help
          Samsung TN Ramdump information region.

menuconfig SEC_DEBUG_SCHED_LOG
        bool "Samsung TN Ramdump information region on memory"
        default y
        help
          Samsung TN Ramdump information region.

menuconfig SEC_DEBUG_IRQ_EXIT_LOG
        bool "Samsung TN Ramdump information region on memory"
        default y
        help
          Samsung TN Ramdump information region.
menuconfig SEC_DEBUG_INFORM_IOREMAP
        bool "Samsung TN Ramdump information region on memory"
        default n
        depends on SEC_DEBUG_INFORM
        help
          Samsung TN Ramdump information region that is dynamically mapped by ioremap_nocache().

menuconfig SEC_DEBUG_INFORM_IOTABLE
        bool "Samsung TN Ramdump information region on memory"
        default y
        depends on SEC_DEBUG_INFORM
        help
          Samsung TN Ramdump information region that is statically mapped by iotable_init().

#endif for SEC_DEBUG
endif

# endif for ARCH_SHMOBILE

menu "Kernel low-level debugging via SuperH SCI(F) port"

config DEBUG_LL_SH_SCI_BASE
	depends on DEBUG_SH_SCI
	hex "Physical base address"
	default "0x00000000"

endmenu

endif
```

## bootable/bootloader/barebox/arch/arm/mach-kotaevm/Kconfig
```kconfig
if ARCH_KOTAEVM

config ARCH_TEXT_BASE
	hex
	default 0x43000000

config MACH_KOTAEVM
	bool "KOTA EVM board"
	default y
	select MACH_HAS_LOWLEVEL_INIT
	help
	  This adds generic code to configure the CPG, GPIO, SDRAM, etc after reset.
	
config BOARDINFO
	default "Renesas KOTAEVM"

source arch/arm/boards/kotaevm/Kconfig 

endif
```

## bootable/bootloader/barebox/src/arch/arm/configs/u2evm_sec_defconfig
```kconfig
CONFIG_U2EVM_SECURITY=y
CONFIG_U2EVM_SECURITY_IMG_ADDRS=0x4E000800
CONFIG_AEABI=y
# CONFIG_ARM_EXCEPTIONS is not set
CONFIG_TEXT_BASE=0xED0C1300
CONFIG_MEMORY_LAYOUT_FIXED=y
CONFIG_STACK_BASE=0x455FE400
CONFIG_STACK_SIZE=0x20000
CONFIG_MALLOC_BASE=0x4561E400
CONFIG_MALLOC_SIZE=0x2000000
CONFIG_CMDLINE_EDITING=y
CONFIG_AUTO_COMPLETE=y
CONFIG_PARTITION=y
CONFIG_DEFAULT_ENVIRONMENT_GENERIC=y
CONFIG_DEFAULT_ENVIRONMENT_PATH="arch/arm/boards/u2evm/env"
CONFIG_DEBUG_INFO=y
CONFIG_CMD_EDIT=y
CONFIG_CMD_SLEEP=y
CONFIG_CMD_SAVEENV=y
CONFIG_CMD_LOADENV=y
CONFIG_CMD_EXPORT=y
CONFIG_CMD_PRINTENV=y
CONFIG_CMD_READLINE=y
CONFIG_CMD_BOOTM_SHOW_TYPE=y
CONFIG_CMD_RESET=y
CONFIG_CMD_GO=y
CONFIG_CMD_TIMEOUT=y
CONFIG_CMD_PARTITION=y
CONFIG_NET=y
CONFIG_NET_DHCP=y
CONFIG_NET_NFS=y
CONFIG_NET_PING=y
CONFIG_NET_TFTP=y
CONFIG_NET_TFTP_PUSH=y
CONFIG_NET_NETCONSOLE=y
CONFIG_MCI=y
CONFIG_MCI_STARTUP=y
CONFIG_FS_CRAMFS=y
CONFIG_FS_FAT=y
CONFIG_FS_FAT_WRITE=y
CONFIG_FS_FAT_LFN=y
```

## bootable/bootloader/barebox/src/arch/arm/mach-u2evm/Kconfig
```kconfig
if ARCH_U2EVM

config ARCH_TEXT_BASE
	hex
	default 0x43000000

config MACH_U2EVM
	bool "U2 EVM board"
	default y
	select MACH_HAS_LOWLEVEL_INIT
	help
	  This adds generic code to configure the CPG, GPIO, SDRAM, etc after reset.
	
config BOARDINFO
	default "Renesas U2EVM"

config U2EVM_SECURITY
	bool "U2 EVM Security"
	
config U2EVM_SECURITY_IMG_ADDRS
	depends on U2EVM_SECURITY
	prompt "Image address"
	hex
	default 0x4E000800
	
source arch/arm/boards/u2evm/Kconfig 

endif
```

## bootable/bootloader/barebox/src/drivers/i2c/busses/Kconfig
```kconfig
#
# Sensor device configuration
#

menu "I2C Hardware Bus support"

config I2C_IMX
	bool "i.MX I2C Master driver"
	depends on ARCH_IMX

config I2C_OMAP
	bool "OMAP I2C Master driver"
	depends on ARCH_OMAP

config R_MOBILE_I2C
	bool "R-Mobile I2C Master driver"
	depends on ARCH_U2EVM
	
endmenu
```

## drivers/char/cc4.2/Kconfig
```kconfig
config CRYPTO_HW_DX_CC42
       tristate 'discretix CC 4.2 device driver'

       help
		select discretix CC 4.2 device driver
```

## drivers/input/touchscreen/imagis/Kconfig
```kconfig
#
# Imagis Touchscreen driver configuration
#

source "drivers/input/touchscreen/imagis/loganlte/Kconfig"
```

## drivers/input/touchscreen/zinitix/Kconfig
```kconfig
#
# ZINITIX Touchscreen driver configuration
#

source "drivers/input/touchscreen/zinitix/loganlte/Kconfig"
source "drivers/input/touchscreen/zinitix/lt02lte/Kconfig"
```

## drivers/pmic/Kconfig
```kconfig
menuconfig PMIC_INTERFACE
	tristate "PowerManagement IC interface support"
	help
	  This enables support for the PowerManagement IC interface.

if PMIC_INTERFACE
config USB_OTG_INTERFACE
	bool "USB-OTG IC interface support"
	default m

config PMIC_TPS80032_POW
	bool "TPS80032 Power Department Support"
	default m

endif # PMIC_INTERFACE
```

## drivers/sec_hal/Kconfig
```kconfig
#
# SEC_HAL Linux Kernel Module Configuration file
#
config ARM_SEC_HAL
	bool "ARM trustzone (TZ) access hardware abstraction layer."
	default n
#	depends ARM
	---help---
	ARM trustzone (TZ) access hardware abstraction layer.


if ARM_SEC_HAL
# RND conf flags to enable early integration. Consider removing asap.

config ARM_SEC_HAL_RT_INIT
	bool "Enable runtime init. Used for TZ binary version check, and initializing runtime resources."
	default n
#	depends ARM_SEC_HAL
	---help---
	Enable runtime init. Used for TZ binary version check, and initializing runtime resources.

config ARM_SEC_HAL_RPC_HANDLER
	bool "Enable sec_hal rpc handler installation."
	default n
#	depends ARM_SEC_HAL
	---help---
	Enable sec_hal rpc handler installation.

config ARM_SEC_HAL_TEST_DISPATCHER
	bool "Use test dispatcher instead of real one."
	default n
#	depends ARM_SEC_HAL
	---help---
	Use test dispatcher instead of real one.

config ARM_SEC_HAL_SDTOC
	bool "Read data from sdram toc instead of using secure services."
	default n
#	depends ARM_SEC_HAL
	---help---
	Read data from sdram toc instead of using secure services.

endif
```

## drivers/sensor/Kconfig
```kconfig
#
# Sensor device configuration
#

menuconfig SENSOR_SUPPORT
	bool "Sensor support"
	default n
	help
		This option adds the support for sensor driver.
		You will also need drivers from the following menu to make use of it.

if SENSOR_SUPPORT

source "drivers/sensor/accelerometer/Kconfig"
source "drivers/sensor/gyroscope/Kconfig"
source "drivers/sensor/proximity/Kconfig"

endif
```

## drivers/sensor/accelerometer/Kconfig
```kconfig
##############################################################
################ LSM303DL driver configuration ###############
##############################################################

menuconfig LSM303DL_DRIVER
	bool "Accelerometer and magnetometer driver enable"
	default y
	help
	  	Enable all drivers for LSM303DLHC chip. These drivers include
		lsm303dl_input, accelerometer and magnetometer driver.
		
if LSM303DL_DRIVER
	source "drivers/sensor/accelerometer/lsm303dl/Kconfig"
endif
```

## drivers/sensor/accelerometer/lsm303dl/Kconfig
```kconfig
##############################################################
################ LSM303DL driver configuration ###############
##############################################################

comment "Accelerometer and magnetometer driver support"

config LSM303DL
	tristate "Accelerometer and magnetometer driver enable"
	default m

	help
	  	Enable all drivers for LSM303DLHC chip. These drivers include
		lsm303dl_input, accelerometer and magnetometer driver.
		

config LSM303DL_ACC_INT1
	bool "Enable INT1 interrupt for accelerometer"
	default n

	help
	  	Enable INT1 interrupt for accelerometer. If interrupt will not be
		used, please select n
		
config LSM303DL_ACC_INT2
	bool "Enable INT2 interrupt for accelerometer"
	default n

	help
	  	Enable INT2 interrupt for accelerometer. If interrupt will not be
		used, please select n
		
config LSM303DL_MAG_INT
	bool "Enable DRDY interrupt for Magnetometer"
	default n

	help
	  	Enable DRDY interrupt for Magnetometer. If interrupt will not be
		used, please select n
```
