/*
 * Device Tree Source for the r8a7373 based loganlte board
 *
 * Copyright (C) 2013 Renesas Mobile
 *
 * This file is licensed under the terms of the GNU General Public License
 * version 2.  This program is licensed "as is" without any warranty of any
 * kind, whether express or implied.
 */

/dts-v1/;
/include/ "r8a7373.dtsi"

/{
	model = "LoganLTE";
	compatible = "renesas,loganlte", "renesas,r8a7373";

	chosen {
		bootargs = "console=ttySC0,115200 earlyprintk=sh-sci.0,115200 ignore_loglevel";
	};

	memory@0x49000000 {
		device_type = "memory";
		reg = <0x49000000 0x37000000>;
	};
 };
